## boards/shields/split34/Kconfig.defconfig
```kconfig
if SHIELD_SPLIT34_LEFT

config ZMK_KEYBOARD_NAME
    default "Gdrik34"

config ZMK_SPLIT_ROLE_CENTRAL
    default y

endif

if SHIELD_SPLIT34_RIGHT

config ZMK_KEYBOARD_NAME
    default "Gdrik34"

endif

if SHIELD_SPLIT34_LEFT || SHIELD_SPLIT34_RIGHT

config ZMK_SPLIT
    default y

endif
```

## boards/shields/split34/Kconfig.shield
```kconfig
 config SHIELD_SPLIT34_LEFT
    def_bool $(shields_list_contains,split34_left)

config SHIELD_SPLIT34_RIGHT
    def_bool $(shields_list_contains,split34_right)
```
